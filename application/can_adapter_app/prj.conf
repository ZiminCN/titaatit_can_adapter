## CMakeLists.txt
```
# SPDX-License-Identifier: Apache-2.0

cmake_minimum_required(VERSION 3.20.0)

set(DTS_ROOT ${CMAKE_CURRENT_LIST_DIR}/../../)
set(BOARD_ROOT ${CMAKE_CURRENT_LIST_DIR}/../../)

include_directories(${CMAKE_CURRENT_SOURCE_DIR}/Core/inc)
include_directories(${CMAKE_CURRENT_SOURCE_DIR}/User/inc)
include_directories(${CMAKE_CURRENT_SOURCE_DIR}/SoftwareVersion)

# Bootloader Class API
include_directories(${CMAKE_CURRENT_SOURCE_DIR}/../../bootloader/can_adapter_bootloader/User/inc)
include_directories(${CMAKE_CURRENT_SOURCE_DIR}/../../bootloader/can_adapter_bootloader/Core/inc)
file(GLOB BOOT_SOURCES ${CMAKE_CURRENT_SOURCE_DIR}/../../bootloader/can_adapter_bootloader/Core/src/flash.cpp 
        ${CMAKE_CURRENT_SOURCE_DIR}/../../bootloader/can_adapter_bootloader/Core/src/boot_can.cpp 
        ${CMAKE_CURRENT_SOURCE_DIR}/../../bootloader/can_adapter_bootloader/Core/src/dev_info.cpp 
        ${CMAKE_CURRENT_SOURCE_DIR}/../../bootloader/can_adapter_bootloader/User/src/boot.cpp)

file(GLOB USER_SOURCES ${CMAKE_CURRENT_SOURCE_DIR}/User/src/*.c*)
file(GLOB CORE_SOURCES ${CMAKE_CURRENT_SOURCE_DIR}/Core/src/*.c*)

include(${CMAKE_CURRENT_LIST_DIR}/SoftwareVersion/version.cmake)

find_package(Zephyr REQUIRED HINTS $ENV{ZEPHYR_BASE})
project(can_adapter)

target_compile_definitions(app PRIVATE _GNU_SOURCE=1)
target_sources(app PRIVATE ${USER_SOURCES} ${CORE_SOURCES} ${BOOT_SOURCES})
```

## prj.conf
```kconfig
CONFIG_CPP=y
CONFIG_STD_CPP17=y
CONFIG_GLIBCXX_LIBCPP=y

CONFIG_PICOLIBC=y
CONFIG_PICOLIBC_IO_FLOAT=y

CONFIG_HEAP_MEM_POOL_SIZE=4096

CONFIG_FLASH=y
CONFIG_FLASH_MAP=y
CONFIG_HWINFO=y
CONFIG_FLASH=y

CONFIG_LOG=y
CONFIG_RTT_CONSOLE=y
CONFIG_USE_SEGGER_RTT=y
# CONFIG_ASSERT=y

CONFIG_REBOOT=y

CONFIG_CAN=y
CONFIG_CAN_STM32_FDCAN=y
CONFIG_CAN_FD_MODE=y
CONFIG_CAN_RX_TIMESTAMP=y
CONFIG_CAN_MANUAL_RECOVERY_MODE=y
# CONFIG_CAN_ACCEPT_RTR=y

# CONFIG_USE_DT_CODE_PARTITION=y
CONFIG_SPEED_OPTIMIZATIONS=y

# #For FSM
CONFIG_SMF=y
# CONFIG_SMF_ANCESTOR_SUPPORT=n
# CONFIG_SMF_INITIAL_TRANSITION=n

## For UART Driver
CONFIG_UART_LINE_CTRL=y
CONFIG_SERIAL=y
CONFIG_UART_INTERRUPT_DRIVEN=y

CONFIG_USB_DEVICE_STACK_NEXT=y
CONFIG_USBD_BOS_SUPPORT=y

CONFIG_MAIN_STACK_SIZE=2048
CONFIG_ISR_STACK_SIZE=4096
CONFIG_KERNEL_MEM_POOL=y
CONFIG_HEAP_MEM_POOL_SIZE=32768
CONFIG_SYSTEM_WORKQUEUE_STACK_SIZE=16384
CONFIG_CACHE_MANAGEMENT=y

# # # For USB ACM
# CONFIG_USB_CDC_ACM=y
# CONFIG_CDC_ACM_IAD=n
# CONFIG_STDOUT_CONSOLE=y
# CONFIG_USB_DEVICE_STACK=n
# CONFIG_USB_DEVICE_PRODUCT="Zimin USB CDC ACM Device"
# CONFIG_USB_DEVICE_PID=0x0001
# CONFIG_USB_DRIVER_LOG_LEVEL_ERR=y
# CONFIG_USB_DEVICE_LOG_LEVEL_ERR=y
# CONFIG_USB_DEVICE_INITIALIZE_AT_BOOT=n
# CONFIG_USB_CDC_ACM_LOG_LEVEL_DBG=y
# #! Note that this is an experimental configuration, but this project must use...
# CONFIG_USB_DEVICE_STACK_NEXT=y

# ## poll 
# # CONFIG_USB_DEVICE_PID=0x0004
# # CONFIG_CONSOLE=y
# # CONFIG_UART_CONSOLE=y

# # CONFIG_WATCHDOG=y
# # CONFIG_TASK_WDT=y
# # CONFIG_TASK_WDT_MIN_TIMEOUT=1000

# # CONFIG_THREAD_ANALYZER=y
# # CONFIG_THREAD_ANALYZER_AUTO=y
# # CONFIG_THREAD_ANALYZER_USE_PRINTK=y
# # CONFIG_THREAD_NAME=y
# # CONFIG_THREAD_ANALYZER_AUTO_INTERVAL=5
```

## src/main.c
```c
// Copyright (c) Direct Drive Technology Co., Ltd. All rights reserved.
// Author: Zi Min <jianming.zeng@directdrivetech.com>
//
// Licensed under the Apache License, Version 2.0 (the "License");
// you may not use this file except in compliance with the License.
// You may obtain a copy of the License at
//
//     http://www.apache.org/licenses/LICENSE-2.0
//
// Unless required by applicable law or agreed to in writing, software
// distributed under the License is distributed on an "AS IS" BASIS,
// WITHOUT WARRANTIES OR CONDITIONS OF ANY KIND, either express or implied.
// See the License for the specific language governing permissions and
// limitations under the License.

#include <stdio.h>
#include <stdlib.h>
#include <string.h>
#include <zephyr/drivers/gpio.h>

#include <zephyr/device.h>
#include <zephyr/kernel.h>
#include <zephyr/logging/log.h>
#include <zephyr/settings/settings.h>

LOG_MODULE_REGISTER(main, CONFIG_TITA_ADAPTER_LOG_LEVEL);

int main(void){
	LOG_INF("Hello World! I am %s", CONFIG_BOARD);

	while(1){
		k_sleep(K_SECONDS(1));
	}
	
	return 0;
}
```
