## CMakeLists.txt
```
# SPDX-License-Identifier: Apache-2.0

cmake_minimum_required(VERSION 3.20.0)

set(DTS_ROOT ${CMAKE_CURRENT_LIST_DIR}/../../)
set(BOARD_ROOT ${CMAKE_CURRENT_LIST_DIR}/../../)

find_package(Zephyr REQUIRED HINTS $ENV{ZEPHYR_BASE})
project(can_adapter)

include_directories(./src)

FILE(GLOB app_sources src/*.c)
target_sources(app PRIVATE ${app_sources})
```

## prj.conf
```kconfig
# nothing here
# CONFIG_DEBUG=y
# CONFIG_TRACING=y
# CONFIG_DEBUG_OPTIMIZATIONS=y
# CONFIG_HEAP_MEM_POOL_SIZE=16384

CONFIG_GPIO=y
CONFIG_LOG=y
CONFIG_LOG_BACKEND_SHOW_COLOR=n
CONFIG_LOG_BACKEND_FORMAT_TIMESTAMP=n
CONFIG_LOG_MODE_IMMEDIATE=n
CONFIG_LOG_MODE_DEFERRED=y
CONFIG_TITA_ADAPTER_LOG_LEVEL_DBG=y
# CONFIG_USB_CDC_ACM_LOG_LEVEL_DBG=y
# CONFIG_CAN_LOG_LEVEL_INF=y
# CONFIG_USB_DEVICE_LOG_LEVEL_DBG=y

CONFIG_UART_LINE_CTRL=y
CONFIG_SERIAL=y
CONFIG_UART_INTERRUPT_DRIVEN=y

CONFIG_USB_DEVICE_STACK=y
CONFIG_USB_DEVICE_MANUFACTURER="Direct Drive Tech"
CONFIG_USB_DEVICE_PRODUCT="TITA Adapter"
CONFIG_USB_CDC_ACM=y
CONFIG_CDC_ACM_IAD=n
CONFIG_USB_DC_STM32=y
CONFIG_USB_CDC_ACM_RINGBUF_SIZE=1024

CONFIG_SEGGER_SYSTEMVIEW_ISR_DESC="I#52=CAN1,I#53=CAN2,I#170=CANFD,I#129=USB"

CONFIG_CONSOLE=y
CONFIG_RTT_CONSOLE=y
CONFIG_USE_SEGGER_RTT=y
# CONFIG_SERIAL=y
# CONFIG_LOG_MODE_MINIMAL=y
# CONFIG_LOG_MAX_LEVEL=2
# CONFIG_LOG_DEFAULT_LEVEL=2



CONFIG_CAN=y
CONFIG_CAN_FD_MODE=y
CONFIG_CAN_DELAY_COMP=y
CONFIG_CAN_AUTO_BUS_OFF_RECOVERY=n

# CONFIG_THREAD_ANALYZER=y
# CONFIG_THREAD_ANALYZER_AUTO=y
# CONFIG_THREAD_NAME=y
# CONFIG_THREAD_ANALYZER_AUTO_INTERVAL=5


# CONFIG_BOOTLOADER_DDTBOOT=y
# CONFIG_USE_DT_CODE_PARTITION=y
# CONFIG_USB_DEVICE_INITIALIZE_AT_BOOT=n
```

## src/main.c
```c
#include "struct.h"
#include "can.h"
#include "acm.h"

LOG_MODULE_REGISTER(main, CONFIG_TITA_ADAPTER_LOG_LEVEL);

static struct adapter_data_t m_adapter_data = {.master_canfd.router_tb[0] =
						       {
							       .is_enable = true,
							       .rang_canid_min = 0x124,
							       .rang_canid_max = 0x124 + 4,
							       .is_tx2master = false,
							       .is_tx2slave = true,
							       .is_tx2peripheral = false,
							       .offset_master = 0,
							       .offset_slave = -4,
							       .offset_peripheral = 0,
						       },
					       .slave_canfd.router_tb[0] = {
						       .is_enable = true,
						       .rang_canid_min = 0x108,
						       .rang_canid_max = 0x108 + 2,
						       .is_tx2master = true,
						       .is_tx2slave = false,
						       .is_tx2peripheral = false,
						       .offset_master = 2,
						       .offset_slave = 0,
						       .offset_peripheral = 0,
					       }};

void main(void)
{
	can_init(&m_adapter_data);
	acm_init(&m_adapter_data);

	while (1) {
		k_sleep(K_MSEC(1000));
	}
}
```

## src/acm.c
```c
#include "acm.h"
#include "protocol.h"

#include <zephyr/kernel.h>
#include <zephyr/device.h>
#include <zephyr/drivers/uart.h>
#include <zephyr/usb/usb_device.h>

const struct device *const acm_dev = DEVICE_DT_GET_ONE(zephyr_cdc_acm_uart);
LOG_MODULE_REGISTER(acm, CONFIG_TITA_ADAPTER_LOG_LEVEL);

K_KERNEL_STACK_DEFINE(deal_work_q_stack, 2048);

static void interrupt_handler(const struct device *dev, void *user_data)
{
	struct adapter_data_t *data = user_data;
	struct acm_data_t *acm_data = &data->user_acm;
	uint32_t recv_len = 0, send_len, rb_len;
	int ret;
	uint8_t *buffer;
	uint8_t drop_data;

	/* get all of the data off UART as fast as we can */
	while (uart_irq_update(dev) && uart_irq_is_pending(dev)) {
		if (uart_irq_rx_ready(dev)) {

			if (ring_buf_is_empty(&acm_data->rx_ringbuf)) {
				ring_buf_reset(&acm_data->rx_ringbuf);
			}

			rb_len = ring_buf_put_claim(&acm_data->rx_ringbuf, &buffer,
						    CONFIG_USB_CDC_ACM_RINGBUF_SIZE);

			if (rb_len == 0) {
				LOG_ERR("acm rx ringbuf is full, drop data");
				ret = ring_buf_put_finish(&acm_data->rx_ringbuf, recv_len);
				if (ret != 0) {
					// put finish error
				}

				// drop all fifo data
				while (uart_fifo_read(dev, &drop_data, sizeof(drop_data)) == 0)
					;

				continue;
			}
			recv_len = uart_fifo_read(dev, buffer, sizeof(recv_len));
			acm_data->dbg_recv_bytes += recv_len;

			if (recv_len < 0) {
				LOG_ERR("Failed to read UART FIFO");
				recv_len = 0;
			};

			if (recv_len == rb_len) {
				// try again read fifo
			}

			ret = ring_buf_put_finish(&acm_data->rx_ringbuf, recv_len);
			if (ret != 0) {
				// put finish error
			}

			if (recv_len) {
				// to send can work queue
				k_work_submit_to_queue(&acm_data->deal_work_q,
						       &acm_data->deal_work);
				// k_work_schedule_for_queue(&acm_data->deal_work_q,
				// 			  &acm_data->deal_work, K_NO_WAIT);
			}
		}

		if (uart_irq_tx_ready(dev)) {
			rb_len = ring_buf_get_claim(&acm_data->tx_ringbuf, &buffer,
						    CONFIG_USB_CDC_ACM_RINGBUF_SIZE);
			if (!rb_len) {
				ring_buf_get_finish(&acm_data->tx_ringbuf, 0);
				LOG_DBG("Ring buffer empty, disable TX IRQ");
				uart_irq_tx_disable(dev);
				continue;
			}

			send_len = uart_fifo_fill(dev, buffer, rb_len);
			if (send_len < rb_len) {
				LOG_ERR("Drop %d bytes", rb_len - send_len);
			}

			ring_buf_get_finish(&acm_data->tx_ringbuf, rb_len);

			acm_data->ring_buf_space = ring_buf_space_get(&acm_data->tx_ringbuf);
			LOG_DBG("ringbuf -> acm fifo %d bytes", send_len);
		}
	}
}

static void acm_data_deal_work_handler(struct k_work *work)
{
	struct adapter_data_t *adapter;
	struct acm_data_t *acm_data;
	acm_data = CONTAINER_OF(work, struct acm_data_t, deal_work);
	adapter = CONTAINER_OF(acm_data, struct adapter_data_t, user_acm);

	uint8_t *rb_buf = 0;
	uint32_t rb_len;
	static int temp = 0;
	rb_len =
		ring_buf_get_claim(&acm_data->rx_ringbuf, &rb_buf, CONFIG_USB_CDC_ACM_RINGBUF_SIZE);
	for (int i = 0; i < rb_len; i++) {
		if (decodec_pack(&acm_data->decodec_data, rb_buf[i]) == true) {
			LOG_INF("cmd:%d", ((uint16_t)(acm_data->decodec_data.RxPackBuffer[4])
					   << 8) | acm_data->decodec_data.RxPackBuffer[3]);
			encodec_pack(adapter, 0x55, (uint8_t *)&temp, sizeof(temp));
			temp++;
		}
	}

	ring_buf_get_finish(&acm_data->rx_ringbuf, rb_len);
}

void acm_init(struct adapter_data_t *adapter_data)
{
	adapter_data->user_acm.dev = acm_dev;

	decodec_init(&adapter_data->user_acm.decodec_data);

	k_work_queue_init(&adapter_data->user_acm.deal_work_q);
	k_work_queue_start(&adapter_data->user_acm.deal_work_q, deal_work_q_stack,
			   K_KERNEL_STACK_SIZEOF(deal_work_q_stack), 0, NULL);
	k_thread_name_set(&adapter_data->user_acm.deal_work_q.thread, "deal_work_q_stack");
	k_work_init(&adapter_data->user_acm.deal_work, acm_data_deal_work_handler);

	ring_buf_init(&adapter_data->user_acm.rx_ringbuf, CONFIG_USB_CDC_ACM_RINGBUF_SIZE,
		      adapter_data->user_acm.rx_buf);
	ring_buf_init(&adapter_data->user_acm.tx_ringbuf, CONFIG_USB_CDC_ACM_RINGBUF_SIZE,
		      adapter_data->user_acm.tx_buf);

	adapter_data->user_acm.ring_buf_size =
		ring_buf_capacity_get(&adapter_data->user_acm.tx_ringbuf);

	int ret = usb_enable(0);
	if (ret != 0) {
		LOG_ERR("failed to enable usb");
		return;
	}

	uart_irq_callback_user_data_set(acm_dev, interrupt_handler, (void *)adapter_data);

	uart_irq_rx_enable(acm_dev);
}
```

## src/acm.h
```c
#pragma once
#include "struct.h"

void acm_init(struct adapter_data_t *adapter_data);
```

## src/boot.h
```c
#pragma once
#undef CAN_MODE_NORMAL
#undef CAN_MODE_LOOPBACK
#include <zephyr/arch/arm/aarch32/cortex_m/cmsis.h>
#include <zephyr/drivers/timer/system_timer.h>
#include <zephyr/drivers/can.h>

struct _id {
	uint32_t sw_version;
	uint32_t mcu_id[3];
};

static void cleanup_arm_nvic(void)
{
	/* Allow any pending interrupts to be recognized */
	__ISB();
	__disable_irq();

	/* Disable NVIC interrupts */
	for (uint8_t i = 0; i < ARRAY_SIZE(NVIC->ICER); i++) {
		NVIC->ICER[i] = 0xFFFFFFFF;
	}
	/* Clear pending NVIC interrupts */
	for (uint8_t i = 0; i < ARRAY_SIZE(NVIC->ICPR); i++) {
		NVIC->ICPR[i] = 0xFFFFFFFF;
	}
}

struct arm_vector_table {
	uint32_t msp;
	uint32_t reset;
};

__attribute__((unused)) static void jump_to_boot(void)
{
	struct arm_vector_table *vt;

	/*application base address = bootloader base address + bootloader size*/
	vt = (struct arm_vector_table *)(CONFIG_FLASH_BASE_ADDRESS);

	LOG_DBG("vt->reset:0x%08x value:0x%08x", (uint32_t)&vt->reset, vt->reset);

	if (IS_ENABLED(CONFIG_SYSTEM_TIMER_HAS_DISABLE_SUPPORT)) {
		sys_clock_disable();
	}

	cleanup_arm_nvic(); /* cleanup NVIC registers */
	__set_MSP(vt->msp);

	__set_CONTROL(0x00); /* application will configures core on its own */
	__ISB();

	LOG_DBG("\r\n");

	((void (*)(void))vt->reset)();
}

/*boot_arg*/
#include <string.h>

#include <zephyr/devicetree.h>
#include <zephyr/storage/flash_map.h>

#define BOOT_ARG_MAGIC 0xDEADC0DE

#define BOOT_ARG_FLAG_NORMAL_BOOT 0
#define BOOT_ARG_FLAG_UPDATE_APP  1
#define BOOT_ARG_FLAG_RECOVERY	  2
#define BOOT_ARG_FLAG_NOT_APP	  3
#define BOOT_ARG_FLAG_APP_BAD	  4

static inline const char *boot_flag_str(int flag)
{
	switch (flag) {
	case BOOT_ARG_FLAG_NORMAL_BOOT:
		return "normal boot";
		break;
	case BOOT_ARG_FLAG_UPDATE_APP:
		return "update app";
		break;
	case BOOT_ARG_FLAG_RECOVERY:
		return "recovery mode";
		break;
	case BOOT_ARG_FLAG_NOT_APP:
		return "not find app";
		break;
	case BOOT_ARG_FLAG_APP_BAD:
		return "app boot abnormal";
		break;
	default:
		return "unrecognize flag";
		break;
	}
}

struct boot_arg {
	int magic; // 0xdeadc0de
	short app_boot_cnt;
	short bl_boot_cnt;
	int flag; // BOOT_ARG_FLAG_[...]
	int app_version;
	int app_checksum;
	int app_size;
	int timestamp;
	int cnt; // write cnt of boot_arg
};

#define BOOT_ARG_AREA FIXED_PARTITION_ID(boot_arg_partition)

static void boot_arg_init(struct boot_arg *arg)
{
	arg->app_size = 0;
	arg->app_checksum = 0;
	arg->magic = BOOT_ARG_MAGIC;
	arg->bl_boot_cnt = 1;
	arg->app_version = 0;
	arg->cnt = 0;
	arg->timestamp = 0;
#ifdef CONFIG_BOOTLOADER_DDTBOOT
	arg->flag = BOOT_ARG_FLAG_NORMAL_BOOT;
#else
	arg->flag = BOOT_ARG_FLAG_NOT_APP;
#endif
}

#ifdef CONFIG_BOOTLOADER_DDTBOOT
static void boot_status_update(struct boot_arg *arg)
{
	if (arg->flag == BOOT_ARG_FLAG_NORMAL_BOOT) {
		if (arg->bl_boot_cnt == 0) {
			arg->bl_boot_cnt = 1;
			arg->flag = BOOT_ARG_FLAG_NORMAL_BOOT;
		} else if (arg->bl_boot_cnt == 0) {
			arg->flag = BOOT_ARG_FLAG_RECOVERY;
		} else {
			arg->flag = BOOT_ARG_FLAG_NORMAL_BOOT;
		}
	}
}
#endif

static int boot_area_free_cnt(void)
{
	const struct flash_area *fap;
	struct flash_sector boot_arg_sector;
	struct boot_arg arg;
	int sec_cnt = 1;
	int i;

	flash_area_open(BOOT_ARG_AREA, &fap);

	flash_area_get_sectors(BOOT_ARG_AREA, &sec_cnt, &boot_arg_sector);

	for (i = 0; i < boot_arg_sector.fs_size; i += sizeof(struct boot_arg)) {
		flash_area_read(fap, i, &arg, sizeof(struct boot_arg));
		if (arg.magic == BOOT_ARG_MAGIC) {
			break;
		} else if (arg.magic != 0xFFFFFFFF) {
			return 0; // data err
		}
	}
	flash_area_close(fap);

	return i / sizeof(struct boot_arg);
}

__attribute__((unused)) static void boot_arg_get(struct boot_arg *arg)
{
	const struct flash_area *fap;
	struct flash_sector boot_arg_sector;
	int sec_cnt = 1;

	memset((void *)arg, 0, sizeof(struct boot_arg));

	flash_area_open(BOOT_ARG_AREA, &fap);

	flash_area_get_sectors(BOOT_ARG_AREA, &sec_cnt, &boot_arg_sector);

	for (int i = 0; i < boot_arg_sector.fs_size; i += sizeof(struct boot_arg)) {
		flash_area_read(fap, i, arg, sizeof(struct boot_arg));
		if (arg->magic == BOOT_ARG_MAGIC) {
#ifdef CONFIG_BOOTLOADER_DDTBOOT
			boot_status_update(arg);
#endif
			goto exit;
		} else if (arg->magic != 0xFFFFFFFF) {
			boot_arg_init(arg);
			goto exit;
		}
	}

	arg->flag = BOOT_ARG_FLAG_NOT_APP;
exit:
	flash_area_close(fap);
}

__attribute__((unused)) static void boot_arg_save(struct boot_arg *arg)
{
	const struct flash_area *fap;
	struct flash_sector boot_arg_sector;
	int sec_cnt = 1;
	int free_cnt = boot_area_free_cnt();
	int rst = 0, retry = 3;

	if (arg->magic != BOOT_ARG_MAGIC) {
		return;
	}

	flash_area_open(BOOT_ARG_AREA, &fap);

	flash_area_get_sectors(BOOT_ARG_AREA, &sec_cnt, &boot_arg_sector);

	if (free_cnt == 0) {
		flash_area_erase(fap, 0, boot_arg_sector.fs_size);
		free_cnt = boot_area_free_cnt();
	}

	arg->cnt++;
	do {
		rst = flash_area_write(fap, (free_cnt - 1) * sizeof(struct boot_arg), arg,
				       sizeof(struct boot_arg));
		retry--;
	} while (rst != 0 && retry > 0);

	flash_area_close(fap);
}
```

## src/can.c
```c
#include <stdio.h>

#include <zephyr/kernel.h>
#include <zephyr/device.h>
#include <zephyr/logging/log.h>

LOG_MODULE_REGISTER(can, CONFIG_TITA_ADAPTER_LOG_LEVEL);

#include "boot.h"
#include "can.h"
#include "protocol.h"

K_KERNEL_STACK_DEFINE(m_master_tx_work_stack, 2048);
K_KERNEL_STACK_DEFINE(m_slave_tx_work_stack, 2048);
K_KERNEL_STACK_DEFINE(m_peripheral_tx_work_stack, 2048);

static const struct device *const m_master_dev = DEVICE_DT_GET(DT_CHOSEN(zephyr_master_canfd));
static const struct device *const m_slave_dev = DEVICE_DT_GET(DT_CHOSEN(zephyr_slave_canfd));
static const struct device *const m_peripheral_dev =
	DEVICE_DT_GET(DT_CHOSEN(zephyr_peripheral_canfd));

const char *state_to_str(enum can_state state)
{
	switch (state) {
	case CAN_STATE_ERROR_ACTIVE:
		return "error-active";
	case CAN_STATE_ERROR_WARNING:
		return "error-warning";
	case CAN_STATE_ERROR_PASSIVE:
		return "error-passive";
	case CAN_STATE_BUS_OFF:
		return "bus-off";
	case CAN_STATE_STOPPED:
		return "stopped";
	default:
		return "unknown";
	}
}

static inline struct canfd_data_t *get_inst_with_ptr(struct adapter_data_t *adapter,
						     const struct device *dev)
{
	struct canfd_data_t *inst = NULL;

	if (dev == adapter->master_canfd.dev) {
		inst = &adapter->master_canfd;
	} else if (dev == adapter->slave_canfd.dev) {
		inst = &adapter->slave_canfd;
	} else if (dev == adapter->peripheral_canfd.dev) {
		inst = &adapter->peripheral_canfd;
	}

	return inst;
}

static void state_change_callback(const struct device *dev, enum can_state state,
				  struct can_bus_err_cnt err_cnt, void *user_data)
{
	struct adapter_data_t *adapter = (struct adapter_data_t *)user_data;
	struct canfd_data_t *inst = get_inst_with_ptr(adapter, dev);

	if (inst) {
		inst->info.state = state;
		memcpy((void *)&inst->info.state_err_cnt, (void *)&err_cnt,
		       sizeof(struct can_bus_err_cnt));
	}

	if (state == CAN_STATE_BUS_OFF) {

		if (can_recover(dev, K_MSEC(100)) != 0) {
			LOG_INF("Recovery timed out\n");
		}
	}
}

static inline void rx2other(struct canfd_data_t *src, struct canfd_data_t *dest,
			    struct can_frame *frame)
{
	uint8_t *buffer;
	uint32_t rb_len;

	rb_len = ring_buf_put_claim(&dest->tx_ringbuf, &buffer, sizeof(struct can_frame));
	if (rb_len == 0) {
		ring_buf_put_finish(&dest->tx_ringbuf, 0);
		if (dest->dev == m_master_dev) {
			src->info.rx2master_drop_cnt++;
		} else if (dest->dev == m_slave_dev) {
			src->info.rx2slave_drop_cnt++;
		} else if (dest->dev == m_peripheral_dev) {
			src->info.rx2peripheral_drop_cnt++;
		}
	} else {
		if (dest->dev == m_master_dev) {
			src->info.rx2master_cnt++;
		} else if (dest->dev == m_slave_dev) {
			src->info.rx2slave_cnt++;
		} else if (dest->dev == m_peripheral_dev) {
			src->info.rx2peripheral_cnt++;
		}
		memcpy((void *)buffer, (void *)frame, sizeof(struct can_frame));
		ring_buf_put_finish(&dest->tx_ringbuf, sizeof(struct can_frame));
		k_work_submit_to_queue(&dest->tx_work_q, &dest->tx_work);
	}
}

static void canfd_rx_callback(const struct device *dev, struct can_frame *frame, void *user_data)
{
	struct adapter_data_t *adapter = (struct adapter_data_t *)user_data;
	struct canfd_data_t *inst = get_inst_with_ptr(adapter, dev);

	if (!inst) {
		return;
	}
	if (inst == &adapter->master_canfd && (frame->flags & CAN_FRAME_IDE)) {

		if (frame->id == 0xB149) {
			jump_to_boot();
		}
	}

	inst->info.rx_cnt++;
#define IS_RANGE(v, min, max) ((v) >= (min) && (v) <= (max)) ? 1 : 0

	for (int i = 0; i < sizeof(inst->router_tb) / sizeof(inst->router_tb[0]); i++) {
		if (inst->router_tb[i].is_enable == true &&
		    IS_RANGE(frame->id, inst->router_tb[i].rang_canid_min,
			     inst->router_tb[i].rang_canid_max)) {
			if (inst->router_tb[i].is_tx2master) {
				frame->id += inst->router_tb[i].offset_master;
				rx2other(inst, &adapter->master_canfd, frame);
			}
			if (inst->router_tb[i].is_tx2slave) {
				frame->id += inst->router_tb[i].offset_slave;
				rx2other(inst, &adapter->slave_canfd, frame);
			}
			if (inst->router_tb[i].is_tx2peripheral) {
				frame->id += inst->router_tb[i].offset_peripheral;
				rx2other(inst, &adapter->peripheral_canfd, frame);
			}
			inst->info.rx_router_cnt++;
			break;
		}
	}
}

static inline void heartbeat(struct canfd_data_t *dest, int mode, int heartbeat_cnt)
{
	struct can_frame *frame;
	uint32_t rb_len;

	if (dest->info.state != CAN_STATE_ERROR_ACTIVE) {
		// LOG_INF("dev:%s %s", dest->dev->name, state_to_str(dest->info.state));
		ring_buf_reset(&dest->tx_ringbuf);
	}
	if (dest->info.state == CAN_STATE_ERROR_PASSIVE) {
		// LOG_INF("dev:%s %s", dest->dev->name, state_to_str(dest->info.state));
		can_stop(dest->dev);
		can_start(dest->dev);
	}

	dest->info.ring_buf_space = ring_buf_space_get(&dest->tx_ringbuf);

	rb_len =
		ring_buf_put_claim(&dest->tx_ringbuf, (uint8_t **)&frame, sizeof(struct can_frame));
	if (rb_len == 0) {
		ring_buf_put_finish(&dest->tx_ringbuf, 0);
		dest->info.heartbeat_drop_cnt++;
	} else {
		// frame->id = 0x381;
		frame->id = 0x9F;
		frame->flags = CAN_FRAME_FDF;
		frame->dlc = can_bytes_to_dlc(12);
		frame->data_32[0] = 0;
		frame->data_32[1] = mode;
		frame->data_32[2] = heartbeat_cnt;
		ring_buf_put_finish(&dest->tx_ringbuf, sizeof(struct can_frame));
		k_work_submit_to_queue(&dest->tx_work_q, &dest->tx_work);
	}
}

static void heartbeat_timer_cb(struct k_timer *timer_id)
{
	struct adapter_data_t *adapter =
		CONTAINER_OF(timer_id, struct adapter_data_t, heartbeat_timer);

	adapter->heartbeat_cnt++;

#define MODE_MASTER	1
#define MODE_SLAVE	2
#define MODE_PERIPHERAL 3

	heartbeat(&adapter->master_canfd, MODE_MASTER, adapter->heartbeat_cnt);
	heartbeat(&adapter->slave_canfd, MODE_SLAVE, adapter->heartbeat_cnt);
	heartbeat(&adapter->peripheral_canfd, MODE_PERIPHERAL, adapter->heartbeat_cnt);

	// encodec_pack(adapter, 0x1234, 0, 0);
	// encodec_pack(adapter, 0x2234, 0, 0);
	// encodec_pack(adapter, 0x3234, 0, 0);
	encodec_pack(adapter, 0x1, (uint8_t *)&adapter->master_canfd.info,
		     sizeof(struct canfd_info_t));
	encodec_pack(adapter, 0x2, (uint8_t *)&adapter->slave_canfd.info,
		     sizeof(struct canfd_info_t));
	encodec_pack(adapter, 0x3, (uint8_t *)&adapter->peripheral_canfd.info,
		     sizeof(struct canfd_info_t));
	encodec_pack(adapter, 0x4, (uint8_t *)&adapter->heartbeat_cnt,
		     sizeof(adapter->heartbeat_cnt));
}

static void tx_work_handler(struct k_work *work)
{
	struct can_frame *frame;
	struct canfd_data_t *inst = CONTAINER_OF(work, struct canfd_data_t, tx_work);

	while (0 != ring_buf_get_claim(&inst->tx_ringbuf, (uint8_t **)&frame,
				       sizeof(struct can_frame))) {

		inst->info.tx_cnt++;
		if (0 != can_send(inst->dev, frame, K_NO_WAIT, NULL, NULL)) {
			inst->info.tx_err_cnt++;
		}

		ring_buf_get_finish(&inst->tx_ringbuf, sizeof(struct can_frame));
	}
}

static inline void __can_init(struct canfd_data_t *inst, void *user_data)
{
	can_mode_t mode = CAN_MODE_NORMAL | CAN_MODE_FD;
	uint32_t rate;
	char thread_name[50];
	struct can_filter filter_stdid_fd = {
		.id = 0x000, .mask = 0x000, .flags = CAN_FILTER_DATA | CAN_FILTER_FDF};
	struct can_filter filter_extid_fd = {.id = 0x000,
					     .mask = 0x000,
					     .flags = CAN_FILTER_DATA | CAN_FILTER_FDF |
						      CAN_FILTER_IDE};
	k_sem_init(&inst->tx_sem, 0, 1);
	ring_buf_init(&inst->tx_ringbuf, sizeof(inst->tx_buf), inst->tx_buf);

	inst->info.ring_buf_size = ring_buf_capacity_get(&inst->tx_ringbuf);

	k_work_queue_init(&inst->tx_work_q);
	k_work_queue_start(&inst->tx_work_q, inst->tx_work_stack, inst->tx_work_stack_size, 0,
			   NULL);
	snprintf(thread_name, sizeof(thread_name), "%s tx_work_q", inst->dev->name);
	k_thread_name_set(&inst->tx_work_q.thread, thread_name);
	k_work_init(&inst->tx_work, tx_work_handler);

	can_get_core_clock(inst->dev, &rate);
	LOG_INF("%s clock: %u", inst->dev->name, rate);

	can_set_mode(inst->dev, mode);
	can_set_state_change_callback(inst->dev, state_change_callback, user_data);
	can_start(inst->dev);

	can_add_rx_filter(inst->dev, canfd_rx_callback, user_data, &filter_stdid_fd);
	can_add_rx_filter(inst->dev, canfd_rx_callback, user_data, &filter_extid_fd);
}

void can_init(struct adapter_data_t *adapter_data)
{

	adapter_data->master_canfd.dev = m_master_dev;
	adapter_data->slave_canfd.dev = m_slave_dev;
	adapter_data->peripheral_canfd.dev = m_peripheral_dev;

	adapter_data->master_canfd.tx_work_stack = m_master_tx_work_stack;
	adapter_data->slave_canfd.tx_work_stack = m_slave_tx_work_stack;
	adapter_data->peripheral_canfd.tx_work_stack = m_peripheral_tx_work_stack;

	adapter_data->master_canfd.tx_work_stack_size =
		K_THREAD_STACK_SIZEOF(m_master_tx_work_stack);
	adapter_data->slave_canfd.tx_work_stack_size = K_THREAD_STACK_SIZEOF(m_slave_tx_work_stack);
	adapter_data->peripheral_canfd.tx_work_stack_size =
		K_THREAD_STACK_SIZEOF(m_peripheral_tx_work_stack);

	__can_init(&adapter_data->master_canfd, (void *)adapter_data);
	__can_init(&adapter_data->slave_canfd, (void *)adapter_data);
	__can_init(&adapter_data->peripheral_canfd, (void *)adapter_data);

	k_timer_init(&adapter_data->heartbeat_timer, heartbeat_timer_cb, NULL);
	k_timer_start(&adapter_data->heartbeat_timer, K_SECONDS(1), K_SECONDS(1));
}
```

## src/can.h
```c
#pragma once
#include "struct.h"

void can_init(struct adapter_data_t *adapter_data);
```

## src/protocol.c
```c
#include "protocol.h"

#include <zephyr/logging/log.h>
#include <zephyr/drivers/uart.h>
#include <zephyr/kernel.h>

LOG_MODULE_REGISTER(tita_protocol, CONFIG_TITA_ADAPTER_LOG_LEVEL);

bool decodec_pack(struct ddt_protocol *decodec_data, unsigned char new_data)
{
	unsigned short packCheck;
	bool ret;
	if (decodec_data->RxPackHand) {
		if (2 == decodec_data->RxPackIndex) {
			decodec_data->RxPackEnd = new_data;
		}

		if (decodec_data->RxPackIndex < sizeof(decodec_data->RxPackBuffer)) {
			decodec_data->RxPackBuffer[decodec_data->RxPackIndex] = new_data;
			decodec_data->RxPackCheck += new_data;
			decodec_data->RxPackIndex++;

			if (decodec_data->RxPackIndex >= decodec_data->RxPackEnd &&
			    decodec_data->RxPackEnd > 4) {
				packCheck =
					*((unsigned short *)&decodec_data
						  ->RxPackBuffer[decodec_data->RxPackIndex - 2]);

				decodec_data->RxPackCheck -=
					decodec_data->RxPackBuffer[decodec_data->RxPackIndex - 2];
				decodec_data->RxPackCheck -=
					decodec_data->RxPackBuffer[decodec_data->RxPackIndex - 1];
				decodec_data->RxPackCheck ^= 0xFFFF;
				LOG_INF("RxPackCheck:%04x packCheck:%04x",
					decodec_data->RxPackCheck, packCheck);
				if (decodec_data->RxPackCheck == packCheck) {
					decodec_data->RcvOkPack++;
					ret = true;
				} else {
					decodec_data->RcvErrPack++;
					ret = false;
				}

				decodec_data->RxPackIndex = 0;
				decodec_data->RxPackHand = false;
				decodec_data->RxPackHandMaybe = false;
				return ret;
			}
		} else {
			decodec_data->RxPackIndex = 0;
			decodec_data->RxPackHand = false;
			decodec_data->RxPackHandMaybe = false;
		}
	} else {
		if (new_data == 0x55) {
			decodec_data->RxPackHandMaybe = true;
		} else {
			if ((new_data == 0xAA) && (decodec_data->RxPackHandMaybe)) {
				decodec_data->RxPackBuffer[0] = 0x55;
				decodec_data->RxPackBuffer[1] = 0xAA;
				decodec_data->RxPackHand = true;
				decodec_data->RxPackIndex = 2;
				decodec_data->RxPackCheck = 0;
			}
			decodec_data->RxPackHandMaybe = false;
		}
	}

	return false;
}

void decodec_init(struct ddt_protocol *decodec_data)
{
	memset((void *)decodec_data, 0, sizeof(struct ddt_protocol));
}

uint32_t encodec_pack(struct adapter_data_t *adapter, uint16_t cmd, uint8_t *data, int len)
{

	// struct canfd_data_t *master_canfd = &adapter->master_canfd;
	// struct canfd_data_t *slave_canfd = &adapter->slave_canfd;
	// struct canfd_data_t *peripheral_canfd = &adapter->peripheral_canfd;
	struct acm_data_t *acm = &adapter->user_acm;
	uint32_t rb_len, ret;
	uint8_t *buffer;
	int pack_len = 2 + 1 + 2 + len + 2;
	uint16_t check_xor;

	rb_len = ring_buf_put_claim(&acm->tx_ringbuf, &buffer, pack_len);
	acm->ring_buf_space = ring_buf_space_get(&acm->tx_ringbuf);

	if (rb_len == 0 || pack_len > rb_len) {
		ring_buf_put_finish(&acm->tx_ringbuf, 0);
		ring_buf_reset(&acm->tx_ringbuf);

		acm->pkg_tx_err_count++;
		return -1;
	}

	buffer[0] = 0x55;
	buffer[1] = 0xaa;
	buffer[2] = pack_len;
	buffer[3] = cmd;
	buffer[4] = cmd >> 8;
	check_xor = buffer[2] + buffer[3] + buffer[4];
	for (rb_len = 0; rb_len < len; rb_len++) {
		buffer[5 + rb_len] = data[rb_len];
		check_xor += data[rb_len];
	}
	check_xor ^= 0xffff;
	buffer[5 + rb_len++] = check_xor;
	buffer[5 + rb_len] = check_xor >> 8;

	ret = ring_buf_put_finish(&acm->tx_ringbuf, pack_len);

	uart_irq_tx_enable(acm->dev);
	// k_sem_give(&acm->tx_sem);
	return ret;
}
```

## src/protocol.h
```c
#pragma once
#include "struct.h"

bool decodec_pack(struct ddt_protocol *decodec_data, unsigned char data);
void decodec_init(struct ddt_protocol *decodec_data);
uint32_t encodec_pack(struct adapter_data_t *adapter, uint16_t cmd, uint8_t *data, int len);
```

## src/struct.h
```c
#pragma once

#include <zephyr/drivers/can.h>
#include <zephyr/logging/log.h>
#include <zephyr/sys/ring_buffer.h>
#include <zephyr/device.h>

struct ddt_protocol {
	int RxPackIndex;
	int RxPackEnd;
	uint16_t RxPackCheck;
	uint8_t RxPackBuffer[CONFIG_USB_CDC_ACM_RINGBUF_SIZE];

	bool RxPackHand;
	bool RxPackHandMaybe;
	uint32_t RcvOkPack;
	uint32_t RcvErrPack;
};

struct canfd_router_t {
	bool is_enable;
	uint16_t rang_canid_min;
	uint16_t rang_canid_max;
	bool is_tx2master;
	bool is_tx2slave;
	bool is_tx2peripheral;
	int16_t offset_master;
	int16_t offset_slave;
	int16_t offset_peripheral;
};

struct canfd_info_t {
	uint32_t rx_cnt;
	uint32_t rx_router_cnt;
	uint32_t rx2master_cnt;
	uint32_t rx2slave_cnt;
	uint32_t rx2peripheral_cnt;
	uint32_t rx2master_drop_cnt;
	uint32_t rx2slave_drop_cnt;
	uint32_t rx2peripheral_drop_cnt;
	uint32_t tx_cnt;
	uint32_t tx_err_cnt;
	uint32_t heartbeat_drop_cnt;
	uint32_t ring_buf_size;
	uint32_t ring_buf_space;
	enum can_state state;
	struct can_bus_err_cnt state_err_cnt;
};

struct canfd_data_t {
	const struct device *dev;

	uint8_t tx_buf[sizeof(struct can_frame) * 100];
	struct ring_buf tx_ringbuf;
	struct k_sem tx_sem;
	struct k_work_q tx_work_q;
	struct k_work tx_work;
	k_thread_stack_t *tx_work_stack;
	int tx_work_stack_size;
	struct canfd_router_t router_tb[20];

	struct canfd_info_t info;
};

struct acm_data_t {
	const struct device *dev;
	uint8_t rx_buf[CONFIG_USB_CDC_ACM_RINGBUF_SIZE];
	uint8_t tx_buf[CONFIG_USB_CDC_ACM_RINGBUF_SIZE];
	struct ring_buf rx_ringbuf;
	struct ring_buf tx_ringbuf;
	struct k_work_q deal_work_q;
	struct k_work deal_work;
	struct ddt_protocol decodec_data;
	uint32_t pkg_tx_err_count;

	uint32_t ring_buf_size;
	uint32_t ring_buf_space;
	uint32_t dbg_recv_bytes;
};
struct adapter_data_t {
	struct acm_data_t user_acm;
	struct canfd_data_t master_canfd;
	struct canfd_data_t slave_canfd;
	struct canfd_data_t peripheral_canfd;

	struct k_timer heartbeat_timer;
	uint32_t heartbeat_cnt;
};
```
