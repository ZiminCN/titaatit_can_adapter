## boards/can_adapter_board/Kconfig.can_adapter
```kconfig
# STM32G474RE Nucleo board configuration

# Copyright (c) 2019 STMicroelectronics.
# SPDX-License-Identifier: Apache-2.0

config  BOARD_CAN_ADAPTER
	select SOC_STM32G473XX

config CAN_ADAPTER_BOOT_ARG_PARTITION_LOAD_SIZE
	hex "boot arg partition load size"
	default 0x800
```

## boards/can_adapter_board/Kconfig.defconfig
```kconfig
# STM32G474RE Nucleo board configuration

# Copyright (c) 2019 STMicroelectronics.
# SPDX-License-Identifier: Apache-2.0

if BOARD_CAN_ADAPTER

config SPI_STM32_INTERRUPT
	default y
	depends on SPI

endif # BOARD_CAN_ADAPTER
```

## boards/can_adapter_board/board.yml
```yaml
board:
  name: can_adapter
  full_name: ST Nucleo G473RC
  vendor: st
  socs:
    - name: stm32g473xx
```

## boards/ddt_titaatit_can_adapter_board/Kconfig.board
```kconfig
# STM32G474RE Nucleo board configuration

# Copyright (c) 2019 STMicroelectronics.
# SPDX-License-Identifier: Apache-2.0

config  BOARD_CAN_ADAPTER
	bool "Nucleo G474RE Development Board"
	depends on SOC_STM32G474XX
```

## boards/ddt_titaatit_can_adapter_board/Kconfig.defconfig
```kconfig
# STM32G474RE Nucleo board configuration

# Copyright (c) 2019 STMicroelectronics.
# SPDX-License-Identifier: Apache-2.0

if BOARD_CAN_ADAPTER

config BOARD
	default "nucleo_g474re"

config SPI_STM32_INTERRUPT
	default y
	depends on SPI

module = TITA_ADAPTER
module-str = tita adapter
source "subsys/logging/Kconfig.template.log_config"

endif # BOARD_NUCLEO_G431RB
```
